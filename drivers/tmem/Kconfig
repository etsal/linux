## drivers/tmem/Kconfig
```kconfig
config TMEM
	bool "Transcendent Memory"
	default y
	help
	  Transcendent Memory capabilities. With this option, it is possible to
	  plug in a simple Transcendent Memory backend (TMEM_PAGELIST), as well
	  as a device that exposes Transcendent Memory functionality to userspace (TMEM_DEV).

if TMEM

	menu "TMEM capabilities"

	config TMEM_PAGELIST
	        tristate "Transcendent Memory pagelist backend"
		default m
		help
		  Simple memory pool used to service Transcendent Memory requests.
		  This dummy backend can be used instead of zswap or Xen for activating
		  Transcendent Memory capabilities.

	config TMEM_DEV
		tristate "Transcendent memory character device"
		default m
		depends on TMEM_PAGELIST != n
		help
		  Character device to be used by userspace when the latter wants to use
		  transactional memory. Using ioctl() calls, the userspace application can
		  take advantage of the put/get semantics that Transcendent Memory provides.

	endmenu

endif
```

## drivers/tmem/tmem_pagelist/Kconfig
```kconfig
config TMEM_PAGELIST
tristate "Tmem naive backend"
default m
help
    Simple memory pool used to emulate tmem using a page list.
```

## drivers/tmem/tmem_user/Kconfig
```kconfig
config TMEM_USER
tristate "Tmem character device (NOT IMPLEMENTED)"
depends on TMEM_PAGELIST
default n
help
    Character device to be used by userspace when the latter wants to use transactional memory
```
